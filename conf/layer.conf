## conf/layer.conf
```bitbake
# We have a conf and classes directory, add to BBPATH
BBPATH .= ":${LAYERDIR}"

# We have a packages directory, add to BBFILES
BBFILES += "\
	${LAYERDIR}/recipes-*/*.bb \
	${LAYERDIR}/recipes-*/*.bbappend \
	${LAYERDIR}/recipes-*/*/*.bb \
	${LAYERDIR}/recipes-*/*/*.bbappend \
"

BBFILE_COLLECTIONS += "imaging-layer"
BBFILE_PATTERN_imaging-layer = "^${LAYERDIR}/"
BBFILE_PRIORITY_imaging-layer = "7"

LAYERDEPENDS_imaging-layer = "core"

LAYERSERIES_COMPAT_imaging-layer = "scarthgap"
```
